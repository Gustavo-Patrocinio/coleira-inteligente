## CMakeLists.txt
```
# Collar logger (Phase 1): streams raw IMU packets (contract 4.4) over BLE.
cmake_minimum_required(VERSION 3.20.0)

find_package(Zephyr REQUIRED HINTS $ENV{ZEPHYR_BASE})
project(collar_logger)

set(COMMON ${CMAKE_CURRENT_SOURCE_DIR}/../common/src)

target_include_directories(app PRIVATE src ${COMMON})
target_sources(app PRIVATE
  src/main.c
  src/ble_raw.c
  ${COMMON}/packet.c
  ${COMMON}/imu.c
)
```

## prj.conf
```kconfig
# ---- Sensor: LSM6DS3TR-C on the XIAO nRF52840 Sense (Zephyr "st,lsm6dsl" driver)
CONFIG_I2C=y
CONFIG_SENSOR=y
CONFIG_LSM6DSL=y
# Full scale fixed at build time (contract 4.2 / ADR 0005): ±16 g, ±2000 dps
CONFIG_LSM6DSL_ACCEL_FS=16
CONFIG_LSM6DSL_GYRO_FS=2000
# ODR 104 Hz (ADR 0010): 4 = 104 Hz in the driver's ODR table
CONFIG_LSM6DSL_ACCEL_ODR=4
CONFIG_LSM6DSL_GYRO_ODR=4
CONFIG_FPU=y

# ---- Bluetooth LE peripheral
CONFIG_BT=y
CONFIG_BT_PERIPHERAL=y
CONFIG_BT_DEVICE_NAME="Collar-Logger"
CONFIG_BT_MAX_CONN=1
# Needed even as a peripheral: bt_gatt_exchange_mtu() lives in the GATT client
CONFIG_BT_GATT_CLIENT=y
# Bigger packets: MTU 247, data length 251, 2M PHY (ADR 0010)
CONFIG_BT_L2CAP_TX_MTU=247
CONFIG_BT_BUF_ACL_TX_SIZE=251
CONFIG_BT_BUF_ACL_RX_SIZE=251
CONFIG_BT_CTLR_DATA_LENGTH_MAX=251
CONFIG_BT_USER_DATA_LEN_UPDATE=y
CONFIG_BT_USER_PHY_UPDATE=y
CONFIG_BT_GAP_AUTO_UPDATE_CONN_PARAMS=n
CONFIG_BT_BUF_ACL_TX_COUNT=10
CONFIG_BT_CONN_TX_MAX=10

# ---- Threads / misc
CONFIG_MAIN_STACK_SIZE=2048
CONFIG_SYSTEM_WORKQUEUE_STACK_SIZE=2048
CONFIG_GPIO=y

# ---- Logging over the USB serial port (development only; disabled by release.conf)
CONFIG_LOG=y
```

## release.conf
```kconfig
# Release overlay (rule: zero printk/logs in release builds).
#   west build -b xiao_ble/nrf52840/sense logger -- -DEXTRA_CONF_FILE=release.conf
CONFIG_LOG=n
CONFIG_PRINTK=n
CONFIG_ASSERT=n
# The NCS and Zephyr boot banners select PRINTK, so they must go too
CONFIG_NCS_BOOT_BANNER=n
CONFIG_BOOT_BANNER=n
# No console at all: the USB serial port only exists for logs (charging is hardware)
CONFIG_CONSOLE=n
CONFIG_SERIAL=n
CONFIG_USB_DEVICE_STACK=n
```

## src/main.c
```c
/*
 * Collar logger (Phase 1): samples the IMU at 50 Hz while a client is subscribed and
 * streams contract 4.4 packets (10 samples each, 5 packets/s) over BLE.
 *
 *   sampler thread:  20 ms timer → imu_read → 10 samples → packet → queue
 *   sender thread:   queue → BLE notify (retries briefly when the stack is busy)
 *
 * `seq` counts every packet created, so drops on the collar (full queue) show up as gaps
 * on the receiving side exactly like radio losses (ADR 0010).
 */
#include <errno.h>
#include <string.h>

#include <zephyr/kernel.h>
#include <zephyr/logging/log.h>
#include <zephyr/sys/atomic.h>

#include "ble_raw.h"
#include "imu.h"
#include "packet.h"

LOG_MODULE_REGISTER(main, LOG_LEVEL_INF);

#define SAMPLE_PERIOD   K_MSEC(20)
#define QUEUE_PACKETS   50 /* 10 s of data buffered while the link is busy */
#define SEND_RETRIES    20
#define SEND_RETRY_WAIT K_MSEC(5)

K_MSGQ_DEFINE(pkt_q, RAW_PKT_SIZE, QUEUE_PACKETS, 4);
K_SEM_DEFINE(stream_sem, 0, 1);
static atomic_t streaming;

static void on_stream(bool enabled)
{
	atomic_set(&streaming, enabled);
	if (enabled) {
		k_sem_give(&stream_sem);
	}
}

static void enqueue(const uint8_t *pkt)
{
	if (k_msgq_put(&pkt_q, pkt, K_NO_WAIT) != 0) {
		uint8_t dropped[RAW_PKT_SIZE];

		/* Queue full: drop the OLDEST packet so the stream stays as fresh as possible. */
		(void)k_msgq_get(&pkt_q, dropped, K_NO_WAIT);
		(void)k_msgq_put(&pkt_q, pkt, K_NO_WAIT);
	}
}

static void sampler_thread(void *a, void *b, void *c)
{
	ARG_UNUSED(a);
	ARG_UNUSED(b);
	ARG_UNUSED(c);

	static struct imu_sample samples[RAW_PKT_SAMPLES];
	static uint8_t pkt[RAW_PKT_SIZE];
	struct k_timer timer;
	uint16_t seq = 0;
	uint32_t errors = 0;

	k_timer_init(&timer, NULL, NULL);

	for (;;) {
		k_sem_take(&stream_sem, K_FOREVER);
		LOG_INF("streaming started");
		k_msgq_purge(&pkt_q);
		k_timer_start(&timer, SAMPLE_PERIOD, SAMPLE_PERIOD);

		size_t n = 0;
		uint32_t first_ms = 0;

		while (atomic_get(&streaming)) {
			k_timer_status_sync(&timer);
			if (n == 0) {
				first_ms = k_uptime_get_32();
			}
			if (imu_read(&samples[n]) != 0) {
				/* Keep timing intact: repeat the previous sample and count the error. */
				samples[n] = samples[n > 0 ? n - 1 : 0];
				errors++;
			}
			if (++n == RAW_PKT_SAMPLES) {
				raw_packet_pack(pkt, seq++, first_ms, samples);
				enqueue(pkt);
				n = 0;
			}
		}
		k_timer_stop(&timer);
		LOG_INF("streaming stopped (seq=%u, imu errors=%u)", seq, errors);
	}
}

static void sender_thread(void *a, void *b, void *c)
{
	ARG_UNUSED(a);
	ARG_UNUSED(b);
	ARG_UNUSED(c);

	static uint8_t pkt[RAW_PKT_SIZE];
	uint32_t sent = 0, dropped = 0;

	for (;;) {
		k_msgq_get(&pkt_q, pkt, K_FOREVER);

		int err = -ENOMEM;

		for (int i = 0; i < SEND_RETRIES && err == -ENOMEM; i++) {
			err = ble_raw_send(pkt, sizeof(pkt));
			if (err == -ENOMEM) {
				k_sleep(SEND_RETRY_WAIT);
			}
		}
		if (err == 0) {
			sent++;
		} else {
			dropped++;
			if (err == -EMSGSIZE) {
				LOG_WRN("MTU too small for %u-byte packets", (unsigned)sizeof(pkt));
			}
		}
		if ((sent + dropped) % 300 == 0) { /* once a minute at 5 packets/s */
			LOG_INF("packets sent=%u dropped=%u", sent, dropped);
		}
	}
}

K_THREAD_DEFINE(sampler, 1536, sampler_thread, NULL, NULL, NULL, 3, 0, 0);
K_THREAD_DEFINE(sender, 1536, sender_thread, NULL, NULL, NULL, 5, 0, 0);

int main(void)
{
	int err = imu_init();

	if (err) {
		LOG_ERR("IMU init failed (%d); check the board is the Sense variant", err);
		return err;
	}
	err = ble_raw_init(on_stream);
	if (err) {
		return err;
	}
	LOG_INF("collar logger ready");
	return 0;
}
```

## src/ble_raw.c
```c
/*
 * BLE peripheral with the raw data service (ADR 0010):
 *   service c01a0000-7e3b-4c5e-9d2a-5f1e8b6a2c10
 *   notify  c01a0001-7e3b-4c5e-9d2a-5f1e8b6a2c10  (contract 4.4 packets)
 */
#include "ble_raw.h"

#include <errno.h>

#include <zephyr/bluetooth/bluetooth.h>
#include <zephyr/bluetooth/conn.h>
#include <zephyr/bluetooth/gatt.h>
#include <zephyr/bluetooth/uuid.h>
#include <zephyr/kernel.h>
#include <zephyr/logging/log.h>
#include <zephyr/sys/atomic.h>

LOG_MODULE_REGISTER(ble_raw, LOG_LEVEL_INF);

#define RAW_SVC_UUID_VAL  BT_UUID_128_ENCODE(0xc01a0000, 0x7e3b, 0x4c5e, 0x9d2a, 0x5f1e8b6a2c10)
#define RAW_CHAR_UUID_VAL BT_UUID_128_ENCODE(0xc01a0001, 0x7e3b, 0x4c5e, 0x9d2a, 0x5f1e8b6a2c10)

static struct bt_uuid_128 raw_svc_uuid = BT_UUID_INIT_128(RAW_SVC_UUID_VAL);
static struct bt_uuid_128 raw_char_uuid = BT_UUID_INIT_128(RAW_CHAR_UUID_VAL);

static struct bt_conn *current_conn;
static atomic_t notify_enabled;
static ble_raw_stream_cb stream_cb;

static void raw_ccc_changed(const struct bt_gatt_attr *attr, uint16_t value)
{
	bool on = (value == BT_GATT_CCC_NOTIFY);

	atomic_set(&notify_enabled, on);
	LOG_INF("raw notifications %s", on ? "on" : "off");
	if (stream_cb) {
		stream_cb(on);
	}
}

BT_GATT_SERVICE_DEFINE(raw_svc,
	BT_GATT_PRIMARY_SERVICE(&raw_svc_uuid),
	BT_GATT_CHARACTERISTIC(&raw_char_uuid.uuid, BT_GATT_CHRC_NOTIFY, BT_GATT_PERM_NONE,
			       NULL, NULL, NULL),
	BT_GATT_CCC(raw_ccc_changed, BT_GATT_PERM_READ | BT_GATT_PERM_WRITE),
);

/* ---------------------------------------------------------------- advertising */

static const struct bt_data ad[] = {
	BT_DATA_BYTES(BT_DATA_FLAGS, (BT_LE_AD_GENERAL | BT_LE_AD_NO_BREDR)),
	BT_DATA(BT_DATA_NAME_COMPLETE, CONFIG_BT_DEVICE_NAME, sizeof(CONFIG_BT_DEVICE_NAME) - 1),
};

static const struct bt_data sd[] = {
	BT_DATA_BYTES(BT_DATA_UUID128_ALL, RAW_SVC_UUID_VAL),
};

static void adv_start(struct k_work *work)
{
	ARG_UNUSED(work);
	struct bt_le_adv_param param = BT_LE_ADV_PARAM_INIT(
		BT_LE_ADV_OPT_CONNECTABLE, BT_GAP_ADV_FAST_INT_MIN_2, BT_GAP_ADV_FAST_INT_MAX_2,
		NULL);
	int err = bt_le_adv_start(&param, ad, ARRAY_SIZE(ad), sd, ARRAY_SIZE(sd));

	if (err && err != -EALREADY) {
		LOG_ERR("advertising failed (%d)", err);
		return;
	}
	LOG_INF("advertising as \"%s\"", CONFIG_BT_DEVICE_NAME);
}

static K_WORK_DEFINE(adv_work, adv_start);

/* ---------------------------------------------------------------- connection */

static void mtu_exchanged(struct bt_conn *conn, uint8_t err,
			  struct bt_gatt_exchange_params *params)
{
	ARG_UNUSED(params);
	LOG_INF("MTU exchange %s, MTU %u", err ? "failed" : "done", bt_gatt_get_mtu(conn));
}

static struct bt_gatt_exchange_params mtu_params = {.func = mtu_exchanged};

static void connected(struct bt_conn *conn, uint8_t err)
{
	if (err) {
		LOG_WRN("connection failed (0x%02x)", err);
		return;
	}
	current_conn = bt_conn_ref(conn);
	LOG_INF("connected");

	/* Ask for what a 128-byte packet stream needs (ADR 0010); the central may refuse. */
	(void)bt_gatt_exchange_mtu(conn, &mtu_params);
	(void)bt_conn_le_data_len_update(conn, BT_LE_DATA_LEN_PARAM_MAX);
	(void)bt_conn_le_phy_update(conn, BT_CONN_LE_PHY_PARAM_2M);

	struct bt_le_conn_param cp = BT_LE_CONN_PARAM_INIT(12, 24, 0, 400); /* 15–30 ms */

	(void)bt_conn_le_param_update(conn, &cp);
}

static void disconnected(struct bt_conn *conn, uint8_t reason)
{
	LOG_INF("disconnected (0x%02x)", reason);
	atomic_set(&notify_enabled, false);
	if (stream_cb) {
		stream_cb(false);
	}
	if (current_conn) {
		bt_conn_unref(current_conn);
		current_conn = NULL;
	}
}

static void recycled(void)
{
	k_work_submit(&adv_work); /* connection object freed: advertise again */
}

BT_CONN_CB_DEFINE(conn_callbacks) = {
	.connected = connected,
	.disconnected = disconnected,
	.recycled = recycled,
};

/* ---------------------------------------------------------------- public API */

int ble_raw_init(ble_raw_stream_cb cb)
{
	stream_cb = cb;

	int err = bt_enable(NULL);

	if (err) {
		LOG_ERR("bt_enable failed (%d)", err);
		return err;
	}
	k_work_submit(&adv_work);
	return 0;
}

int ble_raw_send(const uint8_t *buf, size_t len)
{
	struct bt_conn *conn = current_conn;

	if (!conn || !atomic_get(&notify_enabled)) {
		return -ENOTCONN;
	}
	if (bt_gatt_get_mtu(conn) < len + 3) {
		return -EMSGSIZE;
	}
	/* attrs[1] is the characteristic declaration; the stack notifies its value. */
	return bt_gatt_notify(conn, &raw_svc.attrs[1], buf, len);
}
```

## src/ble_raw.h
```c
#ifndef COLLAR_BLE_RAW_H_
#define COLLAR_BLE_RAW_H_

#include <stdbool.h>
#include <stddef.h>
#include <stdint.h>

/* Called from the BT thread when a client enables/disables raw notifications. */
typedef void (*ble_raw_stream_cb)(bool enabled);

int ble_raw_init(ble_raw_stream_cb cb);

/* Sends one contract 4.4 packet. Returns 0, -ENOTCONN (no subscriber), -EMSGSIZE
 * (MTU too small) or -ENOMEM (stack buffers full, try again shortly). */
int ble_raw_send(const uint8_t *buf, size_t len);

#endif /* COLLAR_BLE_RAW_H_ */
```

## src/imu.c
```c
/*
 * IMU access through Zephyr's generic sensor API (ADR 0010): values come in m/s² and rad/s
 * and are converted back to int16 at the contract's full scale. Swapping the IMU (Phase 5)
 * only changes the devicetree node and Kconfig, not this conversion.
 */
#include "imu.h"

#include <errno.h>
#include <math.h>

#include <zephyr/device.h>
#include <zephyr/drivers/sensor.h>
#include <zephyr/logging/log.h>

LOG_MODULE_REGISTER(imu, LOG_LEVEL_INF);

#define STANDARD_GRAVITY 9.80665f
#define RAD_TO_DEG       57.29577951f

static const struct device *const imu = DEVICE_DT_GET_ONE(st_lsm6dsl);

static float to_float(const struct sensor_value *v)
{
	return (float)v->val1 + (float)v->val2 / 1000000.0f;
}

static int16_t to_raw(float value, float full_scale)
{
	float r = roundf(value / full_scale * 32768.0f);

	if (r > 32767.0f) {
		return INT16_MAX;
	}
	if (r < -32768.0f) {
		return INT16_MIN;
	}
	return (int16_t)r;
}

int imu_init(void)
{
	if (!device_is_ready(imu)) {
		LOG_ERR("IMU %s not ready", imu->name);
		return -ENODEV;
	}
	LOG_INF("IMU %s ready (accel ±%d g, gyro ±%d dps)", imu->name, (int)IMU_ACCEL_FS_G,
		(int)IMU_GYRO_FS_DPS);
	return 0;
}

int imu_read(struct raw_sample *out)
{
	struct sensor_value a[3], g[3];
	int err = sensor_sample_fetch(imu);

	if (err) {
		return err;
	}
	err = sensor_channel_get(imu, SENSOR_CHAN_ACCEL_XYZ, a);
	if (err) {
		return err;
	}
	err = sensor_channel_get(imu, SENSOR_CHAN_GYRO_XYZ, g);
	if (err) {
		return err;
	}
	for (int i = 0; i < 3; i++) {
		out->v[i] = to_raw(to_float(&a[i]) / STANDARD_GRAVITY, IMU_ACCEL_FS_G);
		out->v[3 + i] = to_raw(to_float(&g[i]) * RAD_TO_DEG, IMU_GYRO_FS_DPS);
	}
	return 0;
}
```

## src/imu.h
```c
#ifndef COLLAR_IMU_H_
#define COLLAR_IMU_H_

#include "packet.h"

/* Full scale of the raw int16 values (contract 4.2 / ADR 0005). */
#define IMU_ACCEL_FS_G    16.0f
#define IMU_GYRO_FS_DPS   2000.0f

int imu_init(void);

/* Reads the latest accel + gyro sample and converts it to raw int16 at the contract's
 * full scale. Returns 0 on success, a negative errno otherwise. */
int imu_read(struct raw_sample *out);

#endif /* COLLAR_IMU_H_ */
```

## src/packet.c
```c
#include "packet.h"

#include <zephyr/sys/byteorder.h>

void raw_packet_pack(uint8_t buf[RAW_PKT_SIZE], uint16_t seq, uint32_t device_ms,
		     const struct raw_sample samples[RAW_PKT_SAMPLES])
{
	buf[0] = RAW_PKT_VERSION;
	buf[1] = RAW_PKT_TYPE_RAW;
	sys_put_le16(seq, &buf[2]);
	sys_put_le32(device_ms, &buf[4]);

	uint8_t *p = &buf[RAW_PKT_HEADER_SIZE];

	for (size_t i = 0; i < RAW_PKT_SAMPLES; i++) {
		for (size_t c = 0; c < RAW_PKT_CHANNELS; c++) {
			sys_put_le16((uint16_t)samples[i].v[c], p);
			p += 2;
		}
	}
}
```

## src/packet.h
```c
/*
 * Raw BLE data packet, contract 4.4 (little-endian):
 *   0  uint8   version (=1)
 *   1  uint8   type (0x01 = raw)
 *   2  uint16  seq (wraps around)
 *   4  uint32  device_ms (uptime of the first sample)
 *   8  int16 x 6 x 10  samples (ax, ay, az, gx, gy, gz)
 * The Python side (ml/src/coleira_ml/raw_packet.py) mirrors this and is unit-tested.
 */
#ifndef COLLAR_PACKET_H_
#define COLLAR_PACKET_H_

#include <stddef.h>
#include <stdint.h>

#define RAW_PKT_VERSION     1
#define RAW_PKT_TYPE_RAW    0x01
#define RAW_PKT_CHANNELS    6
#define RAW_PKT_SAMPLES     10
#define RAW_PKT_HEADER_SIZE 8
#define RAW_PKT_SIZE        (RAW_PKT_HEADER_SIZE + RAW_PKT_SAMPLES * RAW_PKT_CHANNELS * 2)

struct raw_sample {
	int16_t v[RAW_PKT_CHANNELS]; /* ax, ay, az, gx, gy, gz (raw, contract full scale) */
};

/* Writes exactly RAW_PKT_SIZE bytes into buf. */
void raw_packet_pack(uint8_t buf[RAW_PKT_SIZE], uint16_t seq, uint32_t device_ms,
		     const struct raw_sample samples[RAW_PKT_SAMPLES]);

#endif /* COLLAR_PACKET_H_ */
```
