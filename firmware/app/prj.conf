## CMakeLists.txt
```
# Collar app (Phase 2): on-chip behavior classification with TensorFlow Lite Micro.
#
# Needs the tflite-micro Zephyr module. In a west workspace from firmware/west.yml it is
# fetched automatically; with a standalone NCS install pass its path:
#   west build ... -- -DZEPHYR_EXTRA_MODULES=C:/ncs/extra/tflite-micro
cmake_minimum_required(VERSION 3.20.0)

find_package(Zephyr REQUIRED HINTS $ENV{ZEPHYR_BASE})
project(collar_app LANGUAGES C CXX)

set(COMMON ${CMAKE_CURRENT_SOURCE_DIR}/../common/src)

target_include_directories(app PRIVATE src ${COMMON})
target_sources(app PRIVATE
  src/main.c
  src/preprocess.c
  src/smoothing.c
  src/summary_builder.c
  src/summary_store.c
  src/ble_sync.c
  src/raw_stream.c
  src/model_runner.cc
  src/model/model_data.c
  ${COMMON}/imu.c
  ${COMMON}/packet.c
)
target_sources_ifdef(CONFIG_BOOTLOADER_MCUBOOT app PRIVATE src/ota.c)
```

## Kconfig
```
menu "Collar app"

config COLLAR_TENSOR_ARENA_SIZE
	int "TensorFlow Lite Micro tensor arena size (bytes)"
	default 16384
	help
	  Working memory for the CNN's activations. The boot log prints how much of it the
	  model actually uses; keep a margin above that number.

endmenu

source "Kconfig.zephyr"
```

## sysbuild.conf
```
# Use the devicetree flash layout (boards/*.overlay) instead of NCS's Partition Manager:
# the XIAO keeps Seeed's UF2 bootloader until MCUboot (Phase 3 OTA), see ADR 0013.
SB_CONFIG_PARTITION_MANAGER=n
```

## prj.conf
```kconfig
# ---- Sensor (same as the logger; contract 4.2 / ADR 0005 / ADR 0010)
CONFIG_I2C=y
CONFIG_SENSOR=y
CONFIG_LSM6DSL=y
CONFIG_LSM6DSL_ACCEL_FS=16
CONFIG_LSM6DSL_GYRO_FS=2000
CONFIG_LSM6DSL_ACCEL_ODR=4
CONFIG_LSM6DSL_GYRO_ODR=4
CONFIG_FPU=y

# ---- TensorFlow Lite Micro with Arm's optimized CMSIS-NN kernels
CONFIG_CPP=y
CONFIG_STD_CPP17=y
CONFIG_TENSORFLOW_LITE_MICRO=y
CONFIG_TENSORFLOW_LITE_MICRO_CMSIS_NN_KERNELS=y
CONFIG_COLLAR_TENSOR_ARENA_SIZE=16384

# ---- Per-minute summaries in flash (ADR 0013; partition layout in boards/*.overlay)
CONFIG_FLASH=y
CONFIG_FLASH_MAP=y
CONFIG_FLASH_PAGE_LAYOUT=y
CONFIG_FCB=y

# ---- BLE peripheral with the summary sync service (contract 4.8)
CONFIG_BT=y
CONFIG_BT_PERIPHERAL=y
CONFIG_BT_DEVICE_NAME="Collar"
CONFIG_BT_MAX_CONN=1
CONFIG_BT_GATT_CLIENT=y
CONFIG_BT_L2CAP_TX_MTU=247
CONFIG_BT_BUF_ACL_TX_SIZE=251
CONFIG_BT_BUF_ACL_RX_SIZE=251
CONFIG_BT_CTLR_DATA_LENGTH_MAX=251
CONFIG_BT_USER_DATA_LEN_UPDATE=y
CONFIG_SYSTEM_WORKQUEUE_STACK_SIZE=2048

# ---- Inference timing (DWT cycle counter)
CONFIG_TIMING_FUNCTIONS=y

# ---- Threads
CONFIG_MAIN_STACK_SIZE=4096

# ---- Logging over the USB serial port (development only; disabled by release.conf)
CONFIG_LOG=y
```

## release.conf
```kconfig
# Release overlay (rule: zero printk/logs in release builds).
#   west build -b xiao_ble/nrf52840/sense app -- -DEXTRA_CONF_FILE=release.conf
CONFIG_LOG=n
CONFIG_PRINTK=n
CONFIG_ASSERT=n
# The NCS and Zephyr boot banners select PRINTK, so they must go too
CONFIG_NCS_BOOT_BANNER=n
CONFIG_BOOT_BANNER=n
# No console at all: the USB serial port only exists for logs (charging is hardware)
CONFIG_CONSOLE=n
CONFIG_SERIAL=n
CONFIG_USB_DEVICE_STACK=n
```

## boards/xiao_ble_nrf52840_sense.overlay
```dts
/*
 * Flash layout for the app (ADR 0013): the default 32 KB storage holds about one day of
 * per-minute summaries, so the code partition shrinks (the app is ~170 KB) and storage grows
 * to 416 KB (~13–14 days). The Adafruit UF2 bootloader regions are untouched.
 *
 *   0x00000 – 0x26FFF  SoftDevice/MBR area (bootloader convention, unchanged)
 *   0x27000 – 0x8BFFF  code   (404 KB)
 *   0x8C000 – 0xF3FFF  storage (416 KB, FCB of summary records)
 *   0xF4000 –          Adafruit UF2 bootloader (unchanged)
 *
 * Phase 3's MCUboot work replaces this layout and must keep ≥ 7 days of storage.
 */

/delete-node/ &code_partition;
/delete-node/ &storage_partition;

&flash0 {
	partitions {
		code_partition: partition@27000 {
			label = "code_partition";
			reg = <0x00027000 0x00065000>;
		};

		storage_partition: partition@8c000 {
			label = "storage";
			reg = <0x0008c000 0x00068000>;
		};
	};
};
```

## src/main.c
```c
/*
 * Collar app, Phase 2: behavior classification on the chip (still on USB).
 *
 *   sampler thread:   20 ms timer → IMU → ring buffer of the last 2 s;
 *                     every 50 samples (1 s) hands a copy of the window to inference
 *   inference thread: preprocess (int8) → CNN (TFLite Micro) → smoothing (ADR 0002)
 *                     → one line per second on the log, plus a per-minute summary
 *
 * Phase 3: each smoothed second also feeds the per-minute summary (contract 4.7), stored in
 * flash and served over the BLE sync service (contract 4.8, ADR 0013). Raw dump mode
 * (ADR 0014) streams contract 4.4 packets while the phone's collection mode is subscribed.
 */
#include <string.h>

#include <zephyr/kernel.h>
#include <zephyr/logging/log.h>
#include <zephyr/timing/timing.h>

#include "ble_sync.h"
#include "imu.h"
#include "model/model_config.h"
#include "model_runner.h"
#include "ota.h"
#include "preprocess.h"
#include "raw_stream.h"
#include "smoothing.h"
#include "summary_builder.h"
#include "summary_store.h"

LOG_MODULE_REGISTER(app, LOG_LEVEL_INF);

BUILD_ASSERT(MODEL_WINDOW == PRE_WINDOW, "model window must match the preprocessing window");
BUILD_ASSERT(MODEL_CHANNELS == PRE_MODEL_CH, "model channels must match preprocessing");
BUILD_ASSERT(MODEL_N_CLASSES <= SMOOTH_MAX_CLASSES, "too many classes for the smoother");

#define SAMPLE_PERIOD K_MSEC(20)
#define STEP_SAMPLES  50 /* 1 s step, 50% overlap (contract 4.3) */

static const uint8_t class_ids[] = MODEL_CLASS_IDS;
static const char *const class_names[] = MODEL_CLASS_NAMES;

/* Double buffer: the sampler fills `pending` while inference works on its own copy. */
static int16_t pending[PRE_WINDOW * PRE_RAW_CH];
static uint32_t pending_t_ms;
K_SEM_DEFINE(window_ready, 0, 1);
K_MUTEX_DEFINE(window_lock);

/* Per-minute summary (Phase 3, ADR 0013): one smoothed label per second goes in, records
 * aligned to epoch minutes go to flash. The BT thread sets the clock, so guard it. */
static struct summary_builder summary;
K_MUTEX_DEFINE(summary_lock);
#define FLAG_BATTERY_NOT_MEASURED 0x01 /* until the fuel gauge (Phase 5) */

static void store_record(const uint8_t record[SB_RECORD_SIZE], void *user)
{
	ARG_UNUSED(user);
	if (store_append(record) != 0) {
		LOG_WRN("could not store a summary record");
	}
}

static void on_time(uint32_t epoch_s)
{
	k_mutex_lock(&summary_lock, K_FOREVER);
	sb_set_clock(&summary, epoch_s, k_uptime_get_32() / 1000U);
	k_mutex_unlock(&summary_lock);
	ble_sync_set_state(0, true);
}

static const char *name_of(uint8_t id)
{
	for (int i = 0; i < MODEL_N_CLASSES; i++) {
		if (class_ids[i] == id) {
			return class_names[i];
		}
	}
	return id == SMOOTH_UNKNOWN ? "unknown" : "?";
}

static void sampler_thread(void *a, void *b, void *c)
{
	ARG_UNUSED(a);
	ARG_UNUSED(b);
	ARG_UNUSED(c);

	static struct sample_ring ring;
	struct k_timer timer;
	struct imu_sample s, last = {0};
	int since_step = 0;

	ring_init(&ring);
	k_timer_init(&timer, NULL, NULL);
	k_timer_start(&timer, SAMPLE_PERIOD, SAMPLE_PERIOD);

	for (;;) {
		k_timer_status_sync(&timer);
		if (imu_read(&s) != 0) {
			s = last; /* rare I2C hiccup: repeat the previous sample, keep timing intact */
		}
		last = s;
		raw_stream_push(&s); /* raw dump mode (ADR 0014), no-op unless subscribed */
		ring_push(&ring, s.v);
		if (ring_full(&ring) && ++since_step >= STEP_SAMPLES) {
			since_step = 0;
			k_mutex_lock(&window_lock, K_FOREVER);
			ring_copy(&ring, pending);
			pending_t_ms = k_uptime_get_32();
			k_mutex_unlock(&window_lock);
			k_sem_give(&window_ready); /* if inference is still busy, this window is skipped */
		}
	}
}

static void inference_thread(void *a, void *b, void *c)
{
	ARG_UNUSED(a);
	ARG_UNUSED(b);
	ARG_UNUSED(c);

	static int16_t window[PRE_WINDOW * PRE_RAW_CH];
	static const struct preprocess_params pp = {
		.accel_fs_g = MODEL_ACCEL_FS_G,
		.gyro_fs_dps = MODEL_GYRO_FS_DPS,
		.ch_scale = MODEL_CH_SCALE,
		.in_scale = MODEL_IN_SCALE,
		.in_zero_point = MODEL_IN_ZERO_POINT,
	};
	struct smooth_cfg sc = {
		.n_classes = MODEL_N_CLASSES,
		.p_event = 0.6f,  /* ADR 0002 initial values; calibrate in Phase 2 */
		.majority_len = 5,
	};
	struct smooth_state ss;
	uint16_t seconds[256] = {0};
	uint32_t windows = 0;
	uint32_t worst_us = 0;

	for (int i = 0; i < MODEL_N_CLASSES; i++) {
		sc.class_id[i] = class_ids[i];
		sc.event_n_min[i] = class_ids[i] == 4 ? 1 : class_ids[i] == 3 ? 2 : 0;
	}
	smooth_init(&ss);
	timing_init();
	timing_start();

	for (;;) {
		uint32_t t_ms;
		float probs[MODEL_N_CLASSES];

		k_sem_take(&window_ready, K_FOREVER);
		k_mutex_lock(&window_lock, K_FOREVER);
		memcpy(window, pending, sizeof(window));
		t_ms = pending_t_ms;
		k_mutex_unlock(&window_lock);

		timing_t t0 = timing_counter_get();

		preprocess_window(window, PRE_WINDOW, model_input(), &pp);
		if (model_invoke(probs) != 0) {
			LOG_ERR("inference failed");
			continue;
		}
		timing_t t1 = timing_counter_get();
		uint32_t us = (uint32_t)(timing_cycles_to_ns(timing_cycles_get(&t0, &t1)) / 1000U);

		worst_us = MAX(worst_us, us);

		int top = 0;

		for (int i = 1; i < MODEL_N_CLASSES; i++) {
			if (probs[i] > probs[top]) {
				top = i;
			}
		}
		uint8_t out = smooth_step(&sc, &ss, probs);

		k_mutex_lock(&summary_lock, K_FOREVER);
		sb_add(&summary, t_ms / 1000U, out);
		sb_flush(&summary, k_uptime_get_32() / 1000U, store_record, NULL);
		k_mutex_unlock(&summary_lock);

		seconds[out]++;
		windows++;
		LOG_INF("t=%u.%03us raw=%s(%d%%) out=%s  %u.%03u ms", t_ms / 1000, t_ms % 1000,
			class_names[top], (int)(probs[top] * 100.0f + 0.5f), name_of(out), us / 1000,
			us % 1000);

		if (windows % 60 == 0) { /* preview of the Phase 3 per-minute summary */
			LOG_INF("--- minute: still=%us walking=%us running=%us shaking=%us unknown=%us",
				seconds[0], seconds[1], seconds[2], seconds[4], seconds[SMOOTH_UNKNOWN]);
			LOG_INF("--- inference worst %u.%03u ms, arena %u/%u bytes", worst_us / 1000,
				worst_us % 1000, (unsigned)model_arena_used(),
				(unsigned)model_arena_size());
			memset(seconds, 0, sizeof(seconds));
		}
	}
}

/* Not started automatically: main() starts them only after the IMU and model are ready. */
K_THREAD_DEFINE(sampler, 1536, sampler_thread, NULL, NULL, NULL, 3, 0, SYS_FOREVER_MS);
K_THREAD_DEFINE(inference, 4096, inference_thread, NULL, NULL, NULL, 6, 0, SYS_FOREVER_MS);

int main(void)
{
	int err = imu_init();

	if (err) {
		LOG_ERR("IMU init failed (%d)", err);
		return err;
	}
	sb_init(&summary);
	summary.flags = FLAG_BATTERY_NOT_MEASURED;
	err = store_init();
	if (err) {
		LOG_ERR("summary storage failed (%d)", err);
		return err;
	}
	raw_stream_init();
	err = ble_sync_init(on_time);
	if (err) {
		LOG_ERR("bluetooth failed (%d)", err);
		return err;
	}
	err = model_init();
	if (err) {
		LOG_ERR("model init failed (%d); arena %u bytes may be too small", err,
			(unsigned)model_arena_size());
		return err;
	}
	LOG_INF("model ready: %d classes, arena used %u of %u bytes", MODEL_N_CLASSES,
		(unsigned)model_arena_used(), (unsigned)model_arena_size());
	k_thread_start(inference);
	k_thread_start(sampler);
	ota_confirm_later(K_SECONDS(30));
	return 0;
}
```

## src/ble_sync.c
```c
/*
 * Summary sync service (contract 4.8 / ADR 0013):
 *   c01a0100  service
 *   c01a0101  Time     write   uint32 epoch_s
 *   c01a0102  Control  write   0x01 + uint32 since_minute_ts  |  0x02 (status)
 *   c01a0103  Data     notify  k × 15-byte records
 *   c01a0104  Status   read/notify  16 bytes
 * Sending runs on a work item so the BT thread is never blocked by flash reads.
 */
#include <stdbool.h>
#include <string.h>

#include "ble_sync.h"
#include "summary_store.h"

#include <errno.h>

#include <zephyr/bluetooth/bluetooth.h>
#include <zephyr/bluetooth/conn.h>
#include <zephyr/bluetooth/gatt.h>
#include <zephyr/bluetooth/uuid.h>
#include <zephyr/kernel.h>
#include <zephyr/logging/log.h>
#include <zephyr/sys/byteorder.h>

LOG_MODULE_REGISTER(ble_sync, LOG_LEVEL_INF);

#define UUID_(n) BT_UUID_128_ENCODE(0xc01a0100 + (n), 0x7e3b, 0x4c5e, 0x9d2a, 0x5f1e8b6a2c10)

static struct bt_uuid_128 svc_uuid = BT_UUID_INIT_128(UUID_(0));
static struct bt_uuid_128 time_uuid = BT_UUID_INIT_128(UUID_(1));
static struct bt_uuid_128 ctrl_uuid = BT_UUID_INIT_128(UUID_(2));
static struct bt_uuid_128 data_uuid = BT_UUID_INIT_128(UUID_(3));
static struct bt_uuid_128 status_uuid = BT_UUID_INIT_128(UUID_(4));

#define STATUS_SIZE      16
#define MAX_PER_NOTIFY   16
#define KIND_INFO        0x80
#define KIND_SYNC_DONE   0x81
#define OP_SEND_SINCE    0x01
#define OP_STATUS        0x02

static struct bt_conn *conn;
static ble_time_cb time_cb;
static uint8_t battery;
static bool clock_ok;
static uint32_t since_ts;
static uint8_t status_buf[STATUS_SIZE];

static void build_status(uint8_t kind, uint32_t count)
{
	struct store_stats s = store_stats();

	status_buf[0] = kind;
	status_buf[1] = clock_ok;
	status_buf[2] = battery;
	status_buf[3] = 0;
	sys_put_le32(kind == KIND_INFO ? s.count : count, &status_buf[4]);
	sys_put_le32(s.oldest_minute_ts, &status_buf[8]);
	sys_put_le32(s.newest_minute_ts, &status_buf[12]);
}

static ssize_t read_status(struct bt_conn *c, const struct bt_gatt_attr *attr, void *buf,
			   uint16_t len, uint16_t offset)
{
	build_status(KIND_INFO, 0);
	return bt_gatt_attr_read(c, attr, buf, len, offset, status_buf, sizeof(status_buf));
}

static struct k_work send_work;
static struct k_work status_work;

static ssize_t write_time(struct bt_conn *c, const struct bt_gatt_attr *attr, const void *buf,
			  uint16_t len, uint16_t offset, uint8_t flags)
{
	if (offset != 0 || len != 4) {
		return BT_GATT_ERR(BT_ATT_ERR_INVALID_ATTRIBUTE_LEN);
	}
	uint32_t epoch = sys_get_le32(buf);

	if (time_cb) {
		time_cb(epoch);
	}
	clock_ok = true;
	LOG_INF("clock set to %u", epoch);
	return len;
}

static ssize_t write_ctrl(struct bt_conn *c, const struct bt_gatt_attr *attr, const void *buf,
			  uint16_t len, uint16_t offset, uint8_t flags)
{
	const uint8_t *b = buf;

	if (offset != 0 || len < 1) {
		return BT_GATT_ERR(BT_ATT_ERR_INVALID_ATTRIBUTE_LEN);
	}
	if (b[0] == OP_SEND_SINCE && len == 5) {
		since_ts = sys_get_le32(&b[1]);
		k_work_submit(&send_work);
	} else if (b[0] == OP_STATUS && len == 1) {
		k_work_submit(&status_work);
	} else {
		return BT_GATT_ERR(BT_ATT_ERR_VALUE_NOT_ALLOWED);
	}
	return len;
}

BT_GATT_SERVICE_DEFINE(sync_svc,
	BT_GATT_PRIMARY_SERVICE(&svc_uuid),
	BT_GATT_CHARACTERISTIC(&time_uuid.uuid, BT_GATT_CHRC_WRITE, BT_GATT_PERM_WRITE, NULL,
			       write_time, NULL),
	BT_GATT_CHARACTERISTIC(&ctrl_uuid.uuid, BT_GATT_CHRC_WRITE, BT_GATT_PERM_WRITE, NULL,
			       write_ctrl, NULL),
	BT_GATT_CHARACTERISTIC(&data_uuid.uuid, BT_GATT_CHRC_NOTIFY, BT_GATT_PERM_NONE, NULL, NULL,
			       NULL),
	BT_GATT_CCC(NULL, BT_GATT_PERM_READ | BT_GATT_PERM_WRITE),
	BT_GATT_CHARACTERISTIC(&status_uuid.uuid, BT_GATT_CHRC_READ | BT_GATT_CHRC_NOTIFY,
			       BT_GATT_PERM_READ, read_status, NULL, NULL),
	BT_GATT_CCC(NULL, BT_GATT_PERM_READ | BT_GATT_PERM_WRITE),
);

/* attribute indices: 0 svc, 1-2 time, 3-4 ctrl, 5-6 data, 7 ccc, 8-9 status, 10 ccc */
#define ATTR_DATA   (&sync_svc.attrs[5])
#define ATTR_STATUS (&sync_svc.attrs[8])

struct batch {
	uint8_t buf[MAX_PER_NOTIFY * SB_RECORD_SIZE];
	int per_notify;
	int n;
	uint32_t sent;
	int err;
};

static int flush_batch(struct batch *b)
{
	if (b->n == 0) {
		return 0;
	}
	int err;

	/* the stack may be out of buffers for a moment: retry briefly */
	for (int i = 0; i < 50; i++) {
		err = bt_gatt_notify(conn, ATTR_DATA, b->buf, b->n * SB_RECORD_SIZE);
		if (err != -ENOMEM) {
			break;
		}
		k_sleep(K_MSEC(5));
	}
	if (err == 0) {
		b->sent += b->n;
	}
	b->n = 0;
	return err;
}

static int add_record(const uint8_t record[SB_RECORD_SIZE], void *user)
{
	struct batch *b = user;

	memcpy(&b->buf[b->n * SB_RECORD_SIZE], record, SB_RECORD_SIZE);
	if (++b->n == b->per_notify) {
		b->err = flush_batch(b);
	}
	return b->err; /* non-zero stops the walk (e.g. disconnected) */
}

static void send_fn(struct k_work *w)
{
	ARG_UNUSED(w);
	if (!conn) {
		return;
	}
	static struct batch b;
	int mtu_records = (bt_gatt_get_mtu(conn) - 3) / SB_RECORD_SIZE;

	b = (struct batch){.per_notify = CLAMP(mtu_records, 1, MAX_PER_NOTIFY)};
	store_walk_since(since_ts, add_record, &b);
	if (b.err == 0) {
		b.err = flush_batch(&b);
	}
	build_status(KIND_SYNC_DONE, b.sent);
	bt_gatt_notify(conn, ATTR_STATUS, status_buf, sizeof(status_buf));
	LOG_INF("sync since %u: %u records sent (err %d)", since_ts, b.sent, b.err);
}

static void status_fn(struct k_work *w)
{
	ARG_UNUSED(w);
	if (conn) {
		build_status(KIND_INFO, 0);
		bt_gatt_notify(conn, ATTR_STATUS, status_buf, sizeof(status_buf));
	}
}

/* ---------------------------------------------------------------- advertising */

static const struct bt_data ad[] = {
	BT_DATA_BYTES(BT_DATA_FLAGS, (BT_LE_AD_GENERAL | BT_LE_AD_NO_BREDR)),
	BT_DATA(BT_DATA_NAME_COMPLETE, CONFIG_BT_DEVICE_NAME, sizeof(CONFIG_BT_DEVICE_NAME) - 1),
};
static const struct bt_data sd[] = {
	BT_DATA_BYTES(BT_DATA_UUID128_ALL, UUID_(0)),
};

static void adv_fn(struct k_work *w)
{
	ARG_UNUSED(w);
	struct bt_le_adv_param p = BT_LE_ADV_PARAM_INIT(
		BT_LE_ADV_OPT_CONNECTABLE, BT_GAP_ADV_SLOW_INT_MIN, BT_GAP_ADV_SLOW_INT_MAX, NULL);
	int err = bt_le_adv_start(&p, ad, ARRAY_SIZE(ad), sd, ARRAY_SIZE(sd));

	if (err && err != -EALREADY) {
		LOG_ERR("advertising failed (%d)", err);
	}
}

static K_WORK_DEFINE(adv_work, adv_fn);

static void connected(struct bt_conn *c, uint8_t err)
{
	if (err) {
		return;
	}
	conn = bt_conn_ref(c);
	static struct bt_gatt_exchange_params mtu = {0};

	(void)bt_gatt_exchange_mtu(c, &mtu);
	(void)bt_conn_le_data_len_update(c, BT_LE_DATA_LEN_PARAM_MAX);
	LOG_INF("client connected");
}

static void disconnected(struct bt_conn *c, uint8_t reason)
{
	if (conn) {
		bt_conn_unref(conn);
		conn = NULL;
	}
	LOG_INF("client disconnected (0x%02x)", reason);
}

static void recycled(void)
{
	k_work_submit(&adv_work);
}

BT_CONN_CB_DEFINE(sync_conn_cb) = {
	.connected = connected,
	.disconnected = disconnected,
	.recycled = recycled,
};

int ble_sync_init(ble_time_cb on_time)
{
	time_cb = on_time;
	k_work_init(&send_work, send_fn);
	k_work_init(&status_work, status_fn);
	int err = bt_enable(NULL);

	if (err) {
		return err;
	}
	k_work_submit(&adv_work);
	return 0;
}

void ble_sync_set_state(uint8_t battery_pct, bool clock_set)
{
	battery = battery_pct;
	clock_ok = clock_set;
}
```

## src/ble_sync.h
```c
/* BLE peripheral with the summary sync service (contract 4.8 / ADR 0013). */
#ifndef COLLAR_BLE_SYNC_H_
#define COLLAR_BLE_SYNC_H_

#include <stdbool.h>
#include <stdint.h>

/* Called (from the BT thread) when a client writes the current epoch time. */
typedef void (*ble_time_cb)(uint32_t epoch_s);

int ble_sync_init(ble_time_cb on_time);

/* Battery and clock state reported in the Status characteristic. */
void ble_sync_set_state(uint8_t battery_pct, bool clock_set);

#endif /* COLLAR_BLE_SYNC_H_ */
```

## src/model_runner.cc
```c
#include "model_runner.h"

#include <tensorflow/lite/micro/micro_interpreter.h>
#include <tensorflow/lite/micro/micro_mutable_op_resolver.h>
#include <tensorflow/lite/schema/schema_generated.h>

#include "model/model_config.h"
#include "model/model_data.h"

namespace {

/* Sized from a measured arena_used_bytes() plus margin; model_init() fails loudly if a
 * new model needs more. */
constexpr size_t kArenaSize = CONFIG_COLLAR_TENSOR_ARENA_SIZE;
alignas(16) uint8_t arena[kArenaSize];

const tflite::Model *model;
tflite::MicroInterpreter *interpreter;
TfLiteTensor *input;
TfLiteTensor *output;

} // namespace

extern "C" int model_init(void)
{
	model = tflite::GetModel(g_model_data);
	if (model->version() != TFLITE_SCHEMA_VERSION) {
		return -1;
	}

	static tflite::MicroMutableOpResolver<MODEL_OP_COUNT> resolver;
	MODEL_REGISTER_OPS(resolver);

	static tflite::MicroInterpreter static_interpreter(model, resolver, arena, kArenaSize);
	interpreter = &static_interpreter;
	if (interpreter->AllocateTensors() != kTfLiteOk) {
		return -2;
	}

	input = interpreter->input(0);
	output = interpreter->output(0);
	if (input->type != kTfLiteInt8 || output->type != kTfLiteInt8) {
		return -3;
	}
	if (input->bytes != MODEL_WINDOW * MODEL_CHANNELS || output->bytes != MODEL_N_CLASSES) {
		return -4;
	}
	return 0;
}

extern "C" int8_t *model_input(void)
{
	return input->data.int8;
}

extern "C" int model_invoke(float *probs)
{
	if (interpreter->Invoke() != kTfLiteOk) {
		return -1;
	}
	for (int i = 0; i < MODEL_N_CLASSES; i++) {
		probs[i] = (output->data.int8[i] - MODEL_OUT_ZERO_POINT) * MODEL_OUT_SCALE;
	}
	return 0;
}

extern "C" size_t model_arena_used(void)
{
	return interpreter ? interpreter->arena_used_bytes() : 0;
}

extern "C" size_t model_arena_size(void)
{
	return kArenaSize;
}
```

## src/model_runner.h
```c
/* Thin C API over TensorFlow Lite Micro, so the rest of the firmware stays in C. */
#ifndef COLLAR_MODEL_RUNNER_H_
#define COLLAR_MODEL_RUNNER_H_

#include <stddef.h>
#include <stdint.h>

#ifdef __cplusplus
extern "C" {
#endif

/* Loads the model, registers its operators and allocates the tensor arena. */
int model_init(void);

/* Pointer to the int8 input tensor [MODEL_WINDOW][MODEL_CHANNELS]. */
int8_t *model_input(void);

/* Runs one inference and writes dequantized class probabilities (MODEL_N_CLASSES). */
int model_invoke(float *probs);

/* Bytes of the tensor arena actually used (measured after allocation). */
size_t model_arena_used(void);
size_t model_arena_size(void);

#ifdef __cplusplus
}
#endif

#endif /* COLLAR_MODEL_RUNNER_H_ */
```

## src/ota.c
```c
#include "ota.h"

#include <zephyr/dfu/mcuboot.h>
#include <zephyr/logging/log.h>

LOG_MODULE_REGISTER(ota, LOG_LEVEL_INF);

static void confirm_work_fn(struct k_work *work)
{
	ARG_UNUSED(work);
	if (boot_is_img_confirmed()) {
		return;
	}
	int err = boot_write_img_confirmed();

	if (err) {
		LOG_ERR("could not confirm the new image (%d); it reverts on the next reset", err);
	} else {
		LOG_INF("new image confirmed");
	}
}

static K_WORK_DELAYABLE_DEFINE(confirm_work, confirm_work_fn);

void ota_confirm_later(k_timeout_t delay)
{
	/* the delay lets the sampler and inference threads run for a while first */
	k_work_schedule(&confirm_work, delay);
}
```

## src/ota.h
```c
/* OTA health check (ADR 0015): a freshly updated image runs in MCUboot's "test" state and is
 * reverted on the next reset unless it confirms itself. main() calls ota_confirm_later() only
 * after the IMU, storage, BLE and model all came up, so an image that cannot even start goes
 * back to the previous one. No-op in builds without MCUboot (the UF2 variant). */
#pragma once

#include <zephyr/kernel.h>

#ifdef CONFIG_BOOTLOADER_MCUBOOT
void ota_confirm_later(k_timeout_t delay);
#else
static inline void ota_confirm_later(k_timeout_t delay)
{
	ARG_UNUSED(delay);
}
#endif
```

## src/preprocess.c
```c
#include "preprocess.h"

#include <math.h>
#include <string.h>

static int8_t quantize(float x, float scale, int32_t zero_point)
{
	float q = roundf(x / scale) + (float)zero_point;

	if (q > 127.0f) {
		return 127;
	}
	if (q < -128.0f) {
		return -128;
	}
	return (int8_t)q;
}

void preprocess_window(const int16_t *raw, int n, int8_t *out,
		       const struct preprocess_params *p)
{
	const float ka = p->accel_fs_g / 32768.0f;
	const float kg = p->gyro_fs_dps / 32768.0f;

	for (int i = 0; i < n; i++) {
		const int16_t *s = &raw[i * PRE_RAW_CH];
		int8_t *o = &out[i * PRE_MODEL_CH];
		float phys[PRE_MODEL_CH];

		for (int c = 0; c < 3; c++) {
			phys[c] = (float)s[c] * ka;
			phys[3 + c] = (float)s[3 + c] * kg;
		}
		phys[6] = sqrtf(phys[0] * phys[0] + phys[1] * phys[1] + phys[2] * phys[2]);

		for (int c = 0; c < PRE_MODEL_CH; c++) {
			o[c] = quantize(phys[c] / p->ch_scale[c], p->in_scale, p->in_zero_point);
		}
	}
}

void ring_init(struct sample_ring *r)
{
	memset(r, 0, sizeof(*r));
}

void ring_push(struct sample_ring *r, const int16_t sample[PRE_RAW_CH])
{
	memcpy(r->s[r->head], sample, sizeof(r->s[0]));
	r->head = (r->head + 1) % PRE_WINDOW;
	if (r->count < PRE_WINDOW) {
		r->count++;
	}
}

bool ring_full(const struct sample_ring *r)
{
	return r->count == PRE_WINDOW;
}

void ring_copy(const struct sample_ring *r, int16_t *out)
{
	/* when full, the oldest sample is at head */
	int start = ring_full(r) ? r->head : 0;

	for (int i = 0; i < r->count; i++) {
		memcpy(&out[i * PRE_RAW_CH], r->s[(start + i) % PRE_WINDOW], sizeof(r->s[0]));
	}
}
```

## src/preprocess.h
```c
/*
 * Window buffer and preprocessing: raw int16 IMU samples → the int8 tensor the CNN expects.
 *
 * Must match training exactly (ml/src/coleira_ml/cnn.py):
 *   physical = raw × full_scale / 32768        (g, dps)
 *   channels = ax, ay, az, gx, gy, gz, |a|     (|a| from the physical accel)
 *   x        = physical / ch_scale[c]          (cnn.INPUT_SCALE)
 *   q        = clamp(round(x / in_scale) + in_zero_point, -128, 127)
 * A host test compares this C code against the Python preprocessing.
 * Pure C, no Zephyr dependencies, so it also builds and runs on a PC.
 */
#ifndef COLLAR_PREPROCESS_H_
#define COLLAR_PREPROCESS_H_

#include <stdbool.h>
#include <stdint.h>

#define PRE_WINDOW   100 /* 2 s at 50 Hz (contract 4.3) */
#define PRE_RAW_CH   6
#define PRE_MODEL_CH 7

struct preprocess_params {
	float accel_fs_g;
	float gyro_fs_dps;
	float ch_scale[PRE_MODEL_CH];
	float in_scale;
	int32_t in_zero_point;
};

/* raw: [n][6] chronological; out: [n][7] model input. */
void preprocess_window(const int16_t *raw, int n, int8_t *out,
		       const struct preprocess_params *p);

/* Ring buffer holding the last PRE_WINDOW samples. */
struct sample_ring {
	int16_t s[PRE_WINDOW][PRE_RAW_CH];
	int head;  /* index where the next sample goes */
	int count; /* number of valid samples (≤ PRE_WINDOW) */
};

void ring_init(struct sample_ring *r);
void ring_push(struct sample_ring *r, const int16_t sample[PRE_RAW_CH]);
bool ring_full(const struct sample_ring *r);
/* Copies the window in chronological order (oldest first) into out[PRE_WINDOW][6]. */
void ring_copy(const struct sample_ring *r, int16_t *out);

#endif /* COLLAR_PREPROCESS_H_ */
```

## src/raw_stream.c
```c
/*
 * Raw dump mode (ADR 0014): same GATT service and packets as firmware/logger (ADR 0010):
 *   service c01a0000-7e3b-4c5e-9d2a-5f1e8b6a2c10
 *   notify  c01a0001-7e3b-4c5e-9d2a-5f1e8b6a2c10  (contract 4.4, 10 samples, 5 packets/s)
 * The sampler packs packets; a low-priority sender thread notifies them, so a busy radio
 * never delays sampling or inference. Drops are visible as `seq` gaps (ADR 0010).
 */
#include "raw_stream.h"

#include <errno.h>

#include <zephyr/bluetooth/conn.h>
#include <zephyr/bluetooth/gatt.h>
#include <zephyr/bluetooth/uuid.h>
#include <zephyr/kernel.h>
#include <zephyr/logging/log.h>
#include <zephyr/sys/atomic.h>

#include "packet.h"

LOG_MODULE_REGISTER(raw_stream, LOG_LEVEL_INF);

#define RAW_SVC_UUID_VAL  BT_UUID_128_ENCODE(0xc01a0000, 0x7e3b, 0x4c5e, 0x9d2a, 0x5f1e8b6a2c10)
#define RAW_CHAR_UUID_VAL BT_UUID_128_ENCODE(0xc01a0001, 0x7e3b, 0x4c5e, 0x9d2a, 0x5f1e8b6a2c10)
#define QUEUE_PACKETS     25 /* 5 s buffered while the link is busy */
#define SEND_RETRIES      20

static struct bt_uuid_128 raw_svc_uuid = BT_UUID_INIT_128(RAW_SVC_UUID_VAL);
static struct bt_uuid_128 raw_char_uuid = BT_UUID_INIT_128(RAW_CHAR_UUID_VAL);

K_MSGQ_DEFINE(raw_q, RAW_PKT_SIZE, QUEUE_PACKETS, 4);
static atomic_t active;
static struct bt_conn *conn;

static void ccc_changed(const struct bt_gatt_attr *attr, uint16_t value)
{
	ARG_UNUSED(attr);
	bool on = value == BT_GATT_CCC_NOTIFY;

	atomic_set(&active, on);
	LOG_INF("raw dump %s", on ? "on" : "off");
}

BT_GATT_SERVICE_DEFINE(raw_svc,
	BT_GATT_PRIMARY_SERVICE(&raw_svc_uuid),
	BT_GATT_CHARACTERISTIC(&raw_char_uuid.uuid, BT_GATT_CHRC_NOTIFY, BT_GATT_PERM_NONE,
			       NULL, NULL, NULL),
	BT_GATT_CCC(ccc_changed, BT_GATT_PERM_READ | BT_GATT_PERM_WRITE),
);

static void connected(struct bt_conn *c, uint8_t err)
{
	if (!err) {
		conn = bt_conn_ref(c);
	}
}

static void disconnected(struct bt_conn *c, uint8_t reason)
{
	ARG_UNUSED(c);
	ARG_UNUSED(reason);
	atomic_set(&active, false);
	if (conn) {
		bt_conn_unref(conn);
		conn = NULL;
	}
}

BT_CONN_CB_DEFINE(raw_conn_cb) = {
	.connected = connected,
	.disconnected = disconnected,
};

bool raw_stream_active(void)
{
	return atomic_get(&active);
}

void raw_stream_push(const struct imu_sample *s)
{
	static struct imu_sample samples[RAW_PKT_SAMPLES];
	static uint8_t pkt[RAW_PKT_SIZE];
	static size_t n;
	static uint32_t first_ms;
	static uint16_t seq;

	if (!atomic_get(&active)) {
		n = 0; /* the next stream starts on a fresh packet */
		return;
	}
	if (n == 0) {
		first_ms = k_uptime_get_32();
	}
	samples[n] = *s;
	if (++n < RAW_PKT_SAMPLES) {
		return;
	}
	n = 0;
	raw_packet_pack(pkt, seq++, first_ms, samples);
	if (k_msgq_put(&raw_q, pkt, K_NO_WAIT) != 0) {
		uint8_t old[RAW_PKT_SIZE];

		/* full: drop the oldest so the stream stays fresh */
		(void)k_msgq_get(&raw_q, old, K_NO_WAIT);
		(void)k_msgq_put(&raw_q, pkt, K_NO_WAIT);
	}
}

static void sender_thread(void *a, void *b, void *c)
{
	ARG_UNUSED(a);
	ARG_UNUSED(b);
	ARG_UNUSED(c);
	static uint8_t pkt[RAW_PKT_SIZE];

	for (;;) {
		k_msgq_get(&raw_q, pkt, K_FOREVER);
		int err = -ENOMEM;

		for (int i = 0; i < SEND_RETRIES && err == -ENOMEM && conn; i++) {
			err = bt_gatt_notify(conn, &raw_svc.attrs[1], pkt, sizeof(pkt));
			if (err == -ENOMEM) {
				k_sleep(K_MSEC(5));
			}
		}
	}
}

/* lowest priority of the app threads: never delays sampling (3) or inference (6) */
K_THREAD_DEFINE(raw_sender, 1024, sender_thread, NULL, NULL, NULL, 8, 0, 0);

void raw_stream_init(void)
{
	k_msgq_purge(&raw_q);
}
```

## src/raw_stream.h
```c
/*
 * Raw dump mode (ADR 0014): the app firmware also serves the logger's raw data service
 * (ADR 0010, contract 4.4 packets), so dataset collection works without reflashing.
 * Streaming runs only while a client is subscribed; recognition keeps running meanwhile.
 */
#ifndef COLLAR_RAW_STREAM_H_
#define COLLAR_RAW_STREAM_H_

#include <stdbool.h>

#include "imu.h"

void raw_stream_init(void);

/* Called by the sampler for every 20 ms sample; cheap no-op when nobody is subscribed. */
void raw_stream_push(const struct imu_sample *s);

bool raw_stream_active(void);

#endif /* COLLAR_RAW_STREAM_H_ */
```

## src/smoothing.c
```c
#include "smoothing.h"

#include <string.h>

void smooth_init(struct smooth_state *s)
{
	memset(s, 0, sizeof(*s));
}

static int majority(const struct smooth_cfg *cfg, const struct smooth_state *s)
{
	uint8_t counts[SMOOTH_MAX_CLASSES] = {0};
	int best = -1;
	int best_count = 0;

	for (int k = 0; k < s->hist_count; k++) {
		counts[s->hist[k]]++;
	}
	/* walk from the newest entry back, so ties go to the most recent class */
	for (int k = 0; k < s->hist_count; k++) {
		int len = cfg->majority_len;
		int idx = (((s->hist_pos - 1 - k) % len) + len) % len;
		int c = s->hist[idx];

		if (counts[c] > best_count) {
			best = c;
			best_count = counts[c];
		}
	}
	return best;
}

uint8_t smooth_step(const struct smooth_cfg *cfg, struct smooth_state *s, const float *probs)
{
	int best_state = -1;
	int best_event = -1;

	for (int i = 0; i < cfg->n_classes; i++) {
		if (cfg->event_n_min[i] == 0) {
			if (best_state < 0 || probs[i] > probs[best_state]) {
				best_state = i;
			}
			continue;
		}
		if (probs[i] >= cfg->p_event) {
			if (s->run[i] < UINT8_MAX) {
				s->run[i]++;
			}
		} else {
			s->run[i] = 0;
		}
		if (s->run[i] >= cfg->event_n_min[i] &&
		    (best_event < 0 || probs[i] > probs[best_event])) {
			best_event = i;
		}
	}

	/* the state history keeps running during events, so the state resumes smoothly */
	if (best_state >= 0) {
		s->hist[s->hist_pos] = (uint8_t)best_state;
		s->hist_pos = (uint8_t)((s->hist_pos + 1) % cfg->majority_len);
		if (s->hist_count < cfg->majority_len) {
			s->hist_count++;
		}
	}

	if (best_event >= 0) {
		return cfg->class_id[best_event];
	}
	int m = majority(cfg, s);

	return m < 0 ? SMOOTH_UNKNOWN : cfg->class_id[m];
}
```

## src/smoothing.h
```c
/*
 * Temporal smoothing of per-window class probabilities (ADR 0002).
 *
 * - State classes (still, walking, running, eating, drinking): majority vote over the
 *   last `majority_len` windows of the most likely state class (ties → most recent).
 * - Event classes (scratching, shaking): an event is active when its probability has been
 *   ≥ p_event for ≥ n_min consecutive windows. An active event overrides the state; if two
 *   are active, the one with the higher probability wins.
 *
 * Pure C, no Zephyr dependencies, so it also builds and runs on a PC (host test).
 */
#ifndef COLLAR_SMOOTHING_H_
#define COLLAR_SMOOTHING_H_

#include <stdint.h>

#define SMOOTH_MAX_CLASSES  8
#define SMOOTH_MAX_MAJORITY 9
#define SMOOTH_UNKNOWN      255

struct smooth_cfg {
	uint8_t n_classes;
	uint8_t class_id[SMOOTH_MAX_CLASSES];    /* contract 4.1 ID of each model output */
	uint8_t event_n_min[SMOOTH_MAX_CLASSES]; /* 0 = state class; ≥ 1 = event class */
	float p_event;
	uint8_t majority_len;                    /* ≤ SMOOTH_MAX_MAJORITY */
};

struct smooth_state {
	uint8_t hist[SMOOTH_MAX_MAJORITY]; /* recent state-class output indices */
	uint8_t hist_count;
	uint8_t hist_pos;
	uint8_t run[SMOOTH_MAX_CLASSES];   /* consecutive windows ≥ p_event, per event class */
};

void smooth_init(struct smooth_state *s);

/* One window in, one contract class ID out (SMOOTH_UNKNOWN if there is no state class). */
uint8_t smooth_step(const struct smooth_cfg *cfg, struct smooth_state *s, const float *probs);

#endif /* COLLAR_SMOOTHING_H_ */
```
